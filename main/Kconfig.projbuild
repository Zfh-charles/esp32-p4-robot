## sdkconfig.defaults.reminder.example
```kconfig
# 轮询提醒功能参考配置（复制到 menuconfig 或合并进本地 sdkconfig）
# 勿直接提交含真实 ngrok 域名的 sdkconfig

CONFIG_BOARD_TYPE_EP_CHAT_P4_ML307=y
CONFIG_USE_ALARM=y
CONFIG_USE_REMINDER_POLL=y

# 替换 YOUR_PUBLIC_HOST 为 ngrok 域名或 VPS 域名
CONFIG_REMINDER_POLL_DEFAULT_URL="http://114.245.178.62:8443/v1/devices/{device_id}/reminders/pending"
CONFIG_REMINDER_POLL_DEFAULT_ACK_URL=""
CONFIG_REMINDER_POLL_INTERVAL_SEC=300
CONFIG_REMINDER_FEEDBACK_SEC=5
CONFIG_REMINDER_WAKE_PHRASE="查提醒"
CONFIG_REMINDER_DIAG_AUTO_HEAL=y
CONFIG_REMINDER_BOOT_DEFER_SEC=5

# MQTT 唤醒：push 后设备立即 GET；轮询间隔作兜底
CONFIG_REMINDER_MQTT_WAKE=y
CONFIG_REMINDER_MQTT_WAKE_DEFAULT_BROKER="114.245.178.62:8883"
CONFIG_REMINDER_MQTT_WAKE_DEFAULT_TOPIC="v1/notify/{mac_clean}"
CONFIG_REMINDER_MQTT_WAKE_DEFAULT_USERNAME="esp32_{mac_clean}"
CONFIG_REMINDER_MQTT_WAKE_DEFAULT_CLIENT_ID="esp32-{mac_clean}"
CONFIG_REMINDER_MQTT_WAKE_DERIVE_PASSWORD=y
CONFIG_REMINDER_MQTT_WAKE_SECRET_SALT="58151b5cc9521d37e732cb49d42c4d356c1e008dee6f1196dab2777d0a60acc4"
# CONFIG_REMINDER_MQTT_TLS_INSECURE is not set
```
